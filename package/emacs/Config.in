## package/emacs/Config.in
```kconfig
config BR2_PACKAGE_EMACS
	bool "emacs"
	select BR2_PACKAGE_HOST_QEMU
	select BR2_PACKAGE_HOST_QEMU_LINUX_USER_MODE
	select BR2_PACKAGE_GNUTLS
	select BR2_PACKAGE_JANSSON
	select BR2_PACKAGE_LIBXML2
```

## package/lynx/Config.in
```kconfig
config BR2_PACKAGE_LYNX
	bool "lynx"
	select BR2_PACKAGE_NCURSES if !BR2_PACKAGE_SLANG
	select BR2_PACKAGE_OPENSSL if !BR2_PACKAGE_GNUTLS
	help
	  The Text Web-Browser.

	  http://lynx.invisible-island.net/
```
